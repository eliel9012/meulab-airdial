#include <Arduino.h>
#include <ArduinoJson.h>
#include <ArduinoOTA.h>
#include <HTTPClient.h>
#include <M5Dial.h>
#include <Preferences.h>
#include <WiFi.h>
#include <WiFiClientSecure.h>
#include <WiFiManager.h>
#include <algorithm>
#include <time.h>
#include "secrets.h"

#include "map_layers.h"  // zoom basemaps, generated by tools/build_map.py

// Anti-aliased serif fonts (tools/build_fonts.py). Fallback: built-in fonts.
#if __has_include("fonts_vlw.h")
#include "fonts_vlw.h"
#define HAVE_VLW 1
#endif

// Airline logos + names by ICAO prefix (tools/build_logos.py, not committed:
// logos are trademarks of their owners). Optional.
#if __has_include("airline_logos.h") && !defined(NO_AIRLINE_LOGOS)
#include "airline_logos.h"
#define HAVE_LOGOS 1
#endif

namespace {
constexpr char FEED_URL[] = "https://radar.meulab.fun/data/aircraft.json";
constexpr char PORTAL_SSID[] = "MeuLab-AirDial";
constexpr uint32_t FETCH_MS = 15000;
constexpr uint32_t WIFI_RETRY_MS = 10000;
constexpr uint32_t PANEL_HIDE_MS = 8000;      // radar panels auto-hide after idle
constexpr uint32_t DIM_MS = 180000;           // dim screen after 3 min idle
constexpr uint32_t ALERT_MS = 10000;          // approach/emergency banner time
constexpr uint32_t PORTAL_AUTO_MS = 60000;    // open setup portal if never online
constexpr uint32_t PORTAL_TIMEOUT_S = 300;
constexpr uint32_t CLOCK_IDLE_MS = 60000;     // idle radar -> clock (empty sky or night)
constexpr uint32_t SIREN_REPEAT_MS = 6000;    // emergency siren repeats until acknowledged
constexpr uint32_t DOUBLE_TAP_MS = 300;
constexpr size_t MAX_SEEN = 400;              // unique aircraft remembered per day
constexpr float APPROACH_NM = 10.0f;
constexpr size_t MAX_AIRCRAFT = 48;  // 2 static copies x 112 B; feed has ~25
constexpr size_t TRAIL_LEN = 5;

// Palette (RGB565)
constexpr uint16_t BG = 0x0864;       // deep navy
constexpr uint16_t PANEL = 0x10E7;
constexpr uint16_t CYAN = 0x36BA;
constexpr uint16_t WHITE = 0xF7BE;
constexpr uint16_t MUTED = 0x9473;
constexpr uint16_t ORANGE = 0xFBA9;
constexpr uint16_t RED = 0xF38B;      // coral: selection
constexpr uint16_t EMERG = 0xF945;    // emergency red
constexpr uint16_t GRID = 0x1A6B;
constexpr uint16_t ALT_GROUND = 0x7C11;
constexpr uint16_t ALT_LOW = 0x6EEF;   // < 10k ft
constexpr uint16_t ALT_HIGH = 0xACBF;  // >= 25k ft (CYAN in between)
constexpr uint16_t MIL = 0xE5A0;       // military (readsb dbFlags bit 0): gold
constexpr uint16_t SPECIAL = 0xEA9A;   // "interesting" (dbFlags bit 1): magenta

// Zoom: radius 96 px = range.
constexpr float RANGES[] = {160, 80, 40, 20};
constexpr size_t ZOOMS = sizeof(RANGES) / sizeof(RANGES[0]);
const uint16_t* const MAPS[ZOOMS] = {MAP_RGB565_160, MAP_RGB565_80, MAP_RGB565_40, MAP_RGB565_20};
constexpr float HOME_LAT = -20.512504f, HOME_LON = -47.400830f;
constexpr float NM_PER_DEG_LAT = 60.0f, NM_PER_DEG_LON = 56.2f;  // matches build_map.py

struct Place {
  const char* name;
  float lat, lon;
  bool airport;
  float maxRange;  // only labelled at this zoom range or closer
};
const Place PLACES[] = {
  {"SIMK", -20.5922f, -47.3829f, true, 20},
  {"UBERABA", -19.7472f, -47.9381f, false, 160},
  {"RIB. PRETO", -21.1775f, -47.8103f, false, 160},
  {"BATATAIS", -20.8911f, -47.5850f, false, 80},
  {"IBIRACI", -20.4611f, -47.1219f, false, 40},
  {"PATROCINIO", -20.6394f, -47.2817f, false, 40},
  {"CRISTAIS", -20.4033f, -47.4200f, false, 20},
};

struct TrailPt {
  int16_t d10;  // distance, 0.1 NM
  int16_t b10;  // bearing, 0.1 deg
};

// Fixed-size fields: no heap. TLS needs ~45 KB of heap next to the 115 KB canvas.
struct Aircraft {
  char call[10] = "";
  char reg[12] = "";
  char type[6] = "";
  char hex[8] = "";
  char desc[22] = "";
  char squawk[5] = "";
  float distance = -1;
  float bearing = -1;
  float speed = -1;
  float track = -1;
  int altitude = -1;
  int16_t vrate = INT16_MIN;  // ft/min, INT16_MIN = unknown
  bool ground = false;
  bool emergency = false;
  uint8_t flags = 0;          // readsb dbFlags: 1 military, 2 interesting, 4 PIA, 8 LADD
  uint32_t firstSeen = 0;     // millis() of first sighting (sort "recentes")
  uint8_t trailN = 0;
  TrailPt trail[TRAIL_LEN];   // oldest first
};

Aircraft planes[MAX_AIRCRAFT];
size_t count = 0;
size_t selected = 0;
size_t zoom = 0;
enum class Screen : uint8_t { Radar, Detail, Stats };
Screen screen = Screen::Radar;
bool clockActive = false;  // radar idle -> clock face (set by draw())
enum class Sort : uint8_t { Near, High, New };
Sort sortMode = Sort::Near;
bool muted = false;
Preferences prefs;
int otaPct = -1;           // >= 0 while an OTA upload runs
bool otaStarted = false;
bool online = false;
bool everOnline = false;
bool feedOK = false;
uint32_t lastFetch = 0;
uint32_t lastSuccess = 0;
uint32_t lastWiFiTry = 0;
uint32_t lastDraw = 0;
bool dirty = false;      // input changed state; redraw on next loop pass
uint32_t lastTone = 0;
uint32_t lastAction = 0;
uint32_t lastInput = 0;
uint32_t lastLoop = 0;
uint32_t maxLoopGap = 0;   // worst UI loop gap since last feed log
uint32_t bootMs = 0;
long lastEncoder = 0;
bool refreshing = false;
String errorText;
M5Canvas* canvas = nullptr;
bool spriteOK = false;

// Button gesture state (hold+turn = zoom, hold 1.2 s = refresh, hold 5 s = Wi-Fi setup).
uint32_t pressStart = 0;
bool pressTurned = false, refreshFired = false, portalFired = false;
bool pendingTap = false;  // single tap waits DOUBLE_TAP_MS for a second one
uint32_t pendingTapAt = 0;

// Banner: transient message in the header (zoom change, approach, emergency).
String banner;
uint16_t bannerColor = CYAN;
uint32_t bannerUntil = 0;
char alertHex[8] = "";  // aircraft highlighted by the last alert
uint32_t alertUntil = 0;
char sirenHex[8] = "";  // emergency still sounding (cleared by any input)
uint32_t sirenNext = 0;
bool lastFetchOk = true;

// Daily stats (reset at local midnight once NTP time is known).
struct AirlineCount { char icao[4]; uint16_t n; };
struct DayStats {
  uint32_t seen[MAX_SEEN];
  uint16_t n = 0, mil = 0;
  float maxDist = -1;
  char maxDistCall[10] = "";
  int maxAlt = -1;
  char maxAltCall[10] = "";
  AirlineCount air[24];
  uint8_t airN = 0;
  int yday = -1;
} stats;

// Brightness
uint8_t dayBrightness = 140, nightBrightness = 45, currentBrightness = 0;
bool timeConfigured = false;

// Wi-Fi setup portal (allocated only while active).
WiFiManager* portal = nullptr;

// ---- Fonts ------------------------------------------------------------------
const lgfx::IFont* F_BIG = &fonts::Orbitron_Light_32;   // detail callsign
const lgfx::IFont* F_CALL = &fonts::FreeSansBold12pt7b;  // radar callsign
const lgfx::IFont* F_MED = &fonts::Font2;                // values
const lgfx::IFont* F_SMALL = &fonts::Font0;              // labels
#ifdef HAVE_VLW
lgfx::VLWfont vlw32, vlw24, vlw16, vlw13, vlw56;
lgfx::PointerWrapper vlwData32, vlwData24, vlwData16, vlwData13, vlwData56;
#endif
const lgfx::IFont* F_CLOCK = &fonts::Orbitron_Light_32;  // idle clock digits

void loadFonts() {
#ifdef HAVE_VLW
  vlwData32.set(FONT_SERIF_32, FONT_SERIF_32_LEN);
  vlwData24.set(FONT_SERIF_24, FONT_SERIF_24_LEN);
  vlwData16.set(FONT_SERIF_16, FONT_SERIF_16_LEN);
  vlwData13.set(FONT_SERIF_13, FONT_SERIF_13_LEN);
  if (vlw32.loadFont(&vlwData32)) F_BIG = &vlw32;
  if (vlw24.loadFont(&vlwData24)) F_CALL = &vlw24;
  if (vlw16.loadFont(&vlwData16)) F_MED = &vlw16;
  if (vlw13.loadFont(&vlwData13)) F_SMALL = &vlw13;
  vlwData56.set(FONT_SERIF_56D, FONT_SERIF_56D_LEN);
  if (vlw56.loadFont(&vlwData56)) F_CLOCK = &vlw56;
#endif
}

// ---- Helpers ----------------------------------------------------------------
// Copies value into dst, trimmed and truncated to fit.
template <size_t N>
void copyClean(char (&dst)[N], const char* value, bool upper = false) {
  if (!value) value = "";
  while (*value == ' ') ++value;
  size_t len = strnlen(value, N - 1);
  while (len && value[len - 1] == ' ') --len;
  for (size_t i = 0; i < len; ++i) dst[i] = upper ? toupper(static_cast<unsigned char>(value[i])) : value[i];
  dst[len] = '\0';
}

lgfx::LGFXBase& gfx() {
  return spriteOK ? static_cast<lgfx::LGFXBase&>(*canvas) : static_cast<lgfx::LGFXBase&>(M5Dial.Display);
}

float range() { return RANGES[zoom]; }
float pxPerNm() { return 96.0f / range(); }

// Truncates s until it fits maxW px in the current font (0 = no limit).
String fit(lgfx::LGFXBase& d, String s, int maxW) {
  if (maxW <= 0 || d.textWidth(s.c_str()) <= maxW) return s;
  while (s.length() > 1 && d.textWidth((s + ".").c_str()) > maxW) s.remove(s.length() - 1);
  return s + ".";
}

// Transparent text (anti-aliased fonts blend with what is underneath).
int text(const String& s, int x, int y, uint16_t color, const lgfx::IFont* font,
         textdatum_t datum = middle_center, int maxW = 0) {
  auto& d = gfx();
  d.setFont(font);
  d.setTextDatum(datum);
  d.setTextSize(1);
  d.setTextColor(color);
  String t = fit(d, s, maxW);
  d.drawString(t.c_str(), x, y);
  return d.textWidth(t.c_str());
}

// Text with a dark halo, legible over map roads and markers.
void textHalo(const String& s, int x, int y, uint16_t color, const lgfx::IFont* font,
              textdatum_t datum = middle_center) {
  for (int dy = -1; dy <= 1; ++dy)
    for (int dx = -1; dx <= 1; ++dx)
      if (dx || dy) text(s, x + dx, y + dy, BG, font, datum);
  text(s, x, y, color, font, datum);
}

int textW(const String& s, const lgfx::IFont* font) {
  auto& d = gfx();
  d.setFont(font);
  d.setTextSize(1);
  return d.textWidth(s.c_str());
}

uint16_t blend565(uint16_t a, uint16_t b, float t) {  // t=0 -> a, 1 -> b
  int ar = a >> 11, ag = (a >> 5) & 63, ab = a & 31;
  int br = b >> 11, bg = (b >> 5) & 63, bb = b & 31;
  return ((ar + int((br - ar) * t)) << 11) | ((ag + int((bg - ag) * t)) << 5) | (ab + int((bb - ab) * t));
}

uint16_t altColor(const Aircraft& p) {
  if (p.ground) return ALT_GROUND;
  if (p.altitude < 0) return MUTED;
  if (p.altitude < 10000) return ALT_LOW;
  if (p.altitude < 25000) return CYAN;
  return ALT_HIGH;
}

bool flashOn() { return (millis() / 350) % 2 == 0; }

bool military(const Aircraft& p) { return p.flags & 1; }
bool special(const Aircraft& p) { return p.flags & 2; }

// Map color: military / interesting override the altitude scale.
uint16_t markerColor(const Aircraft& p) {
  if (military(p)) return MIL;
  if (special(p)) return SPECIAL;
  return altColor(p);
}

bool localTime(struct tm& t) { return timeConfigured && getLocalTime(&t, 0); }

// 22h-7h: silence (except emergencies) and clock face when idle.
bool nightTime() {
  struct tm t;
  return localTime(t) && (t.tm_hour >= 22 || t.tm_hour < 7);
}

const char* sortName() {
  switch (sortMode) {
    case Sort::High: return "ALTITUDE";
    case Sort::New: return "RECENTES";
    default: return "PERTO";
  }
}

struct Airline {
  const char* name;
  const uint16_t* logo24;
  const uint16_t* logo36;
};

// Callsign "GLO1490" -> GLO. Airline flights only: 3 letters then a digit.
bool airlineCall(const char* c) {
  return isalpha(c[0]) && isalpha(c[1]) && isalpha(c[2]) && isdigit(c[3]);
}

Airline airlineByPrefix(const char* c) {
#ifdef HAVE_LOGOS
  {
    size_t lo = 0, hi = AIRLINES_COUNT;
    while (lo < hi) {
      size_t mid = (lo + hi) / 2;
      int cmp = strncmp(AIRLINES[mid].icao, c, 3);
      if (cmp == 0) return {AIRLINES[mid].name, AIRLINES[mid].logo24, AIRLINES[mid].logo36};
      if (cmp < 0) lo = mid + 1; else hi = mid;
    }
  }
#endif
  return {nullptr, nullptr, nullptr};
}

Airline airlineFor(const Aircraft& p) {
  return airlineCall(p.call) ? airlineByPrefix(p.call) : Airline{nullptr, nullptr, nullptr};
}

void logo(lgfx::LGFXBase& d, const uint16_t* img, int size, int x, int y) {
  d.pushImage(x, y, size, size, reinterpret_cast<const lgfx::rgb565_t*>(img));
}

String label(const Aircraft& p) { return p.call[0] ? String(p.call) : String(p.hex); }

String altText(const Aircraft& p, const char* unit = " ft") {
  if (p.ground) return "SOLO";
  return p.altitude >= 0 ? String(p.altitude) + unit : String("--");
}

String vrateText(const Aircraft& p) {
  if (p.ground || p.vrate == INT16_MIN) return "--";
  if (abs(p.vrate) < 200) return "NIVELADO";
  return (p.vrate > 0 ? "+" : "") + String(static_cast<int>(p.vrate)) + " fpm";
}

// Small up/down triangle for climb/descent, centered at x,y.
void vrateIcon(lgfx::LGFXBase& d, const Aircraft& p, int x, int y, uint16_t color) {
  if (p.ground || p.vrate == INT16_MIN || abs(p.vrate) < 200) return;
  if (p.vrate > 0) d.fillTriangle(x, y - 4, x - 4, y + 3, x + 4, y + 3, color);
  else d.fillTriangle(x, y + 4, x - 4, y - 3, x + 4, y - 3, color);
}

void polarToXY(float distNm, float bearingDeg, int& x, int& y) {
  float a = bearingDeg * DEG_TO_RAD, r = distNm * pxPerNm();
  x = 120 + lroundf(sinf(a) * r);
  y = 120 - lroundf(cosf(a) * r);
}

void geoToXY(float lat, float lon, int& x, int& y) {
  x = 120 + lroundf((lon - HOME_LON) * NM_PER_DEG_LON * pxPerNm());
  y = 120 - lroundf((lat - HOME_LAT) * NM_PER_DEG_LAT * pxPerNm());
}

bool inRange(const Aircraft& p) { return p.distance >= 0 && p.bearing >= 0 && p.distance <= range(); }

void showBanner(const String& msg, uint16_t color, uint32_t ms) {
  banner = msg;
  bannerColor = color;
  bannerUntil = millis() + ms;
}

void touchInput() {
  lastInput = millis();
  sirenHex[0] = '\0';  // any input acknowledges a sounding emergency
}

// ---- Sound ------------------------------------------------------------------
// Non-blocking note queue; loop() plays the next note when the previous ends.
enum class Snd : uint8_t { Tick, ZoomTick, Wrap, Approach, Siren, Military, FeedFail, RefreshDone, Mute, Unmute };
struct Note { uint16_t freq, ms, gap; };
constexpr size_t SOUND_Q = 12;
Note soundQ[SOUND_Q];
size_t soundHead = 0, soundLen = 0;
uint32_t soundNextAt = 0;

void queueNote(uint16_t freq, uint16_t ms, uint16_t gap = 0) {
  if (soundLen < SOUND_Q) soundQ[(soundHead + soundLen++) % SOUND_Q] = {freq, ms, gap};
}

void play(Snd s) {
  bool always = s == Snd::Siren || s == Snd::Mute || s == Snd::Unmute;
  if (!always && (muted || nightTime())) return;
  switch (s) {
    case Snd::Tick:  // detent: short soft click, throttled so fast spins don't flood
      if (millis() - lastTone < 35 || soundLen) return;
      lastTone = millis();
      queueNote(3600, 4);
      break;
    case Snd::ZoomTick: queueNote(2200 + zoom * 450, 7); break;  // closer = higher
    case Snd::Wrap: queueNote(4200, 4, 45); queueNote(4200, 4); break;
    case Snd::Approach: queueNote(1319, 90, 30); queueNote(1760, 150); break;
    case Snd::Siren:
      soundLen = 0;  // pre-empt anything queued
      for (int i = 0; i < 3; ++i) { queueNote(1400, 160, 10); queueNote(950, 160, 10); }
      break;
    case Snd::Military: queueNote(988, 70, 40); queueNote(988, 70, 40); queueNote(1319, 120); break;
    case Snd::FeedFail: queueNote(330, 140); break;
    case Snd::RefreshDone: queueNote(2400, 12); break;
    case Snd::Mute: queueNote(1800, 40, 30); queueNote(1200, 60); break;
    case Snd::Unmute: queueNote(1200, 40, 30); queueNote(1800, 60); break;
  }
}

void serviceSound() {
  if (!soundLen || millis() < soundNextAt) return;
  Note n = soundQ[soundHead];
  soundHead = (soundHead + 1) % SOUND_Q;
  --soundLen;
  M5Dial.Speaker.tone(n.freq, n.ms);
  soundNextAt = millis() + n.ms + n.gap;
}

// ---- Radar drawing ----------------------------------------------------------
// Fading sweep: tints map pixels inside a 40 deg wedge trailing the beam.
void drawSweep(lgfx::LGFXBase& d) {
  if (!spriteOK) return;
  constexpr float WIDTH = 70.0f, R = 96.0f;
  constexpr uint16_t TINT = 0x2EF5;  // green-cyan
  float lead = fmodf(millis() * 0.09f, 360.0f);  // 4 s per turn
  // Bounding box of the wedge: center, both edges, and any axis crossed.
  float minX = 0, maxX = 0, minY = 0, maxY = 0;
  auto extend = [&](float deg) {
    float a = deg * DEG_TO_RAD, x = sinf(a) * R, y = -cosf(a) * R;
    minX = std::min(minX, x); maxX = std::max(maxX, x);
    minY = std::min(minY, y); maxY = std::max(maxY, y);
  };
  extend(lead);
  extend(lead - WIDTH);
  for (int axis = 0; axis < 720; axis += 90)
    if (axis - 360 < lead && axis - 360 > lead - WIDTH) extend(axis - 360);
    else if (axis < lead && axis > lead - WIDTH) extend(axis);
  for (int y = int(minY); y <= int(maxY); ++y) {
    for (int x = int(minX); x <= int(maxX); ++x) {
      if (x * x + y * y > R * R || (x == 0 && y == 0)) continue;
      float theta = atan2f(x, -y) * RAD_TO_DEG;
      float behind = fmodf(lead - theta + 720.0f, 360.0f);
      if (behind > WIDTH) continue;
      float f = 1.0f - behind / WIDTH;
      float alpha = f * f * f * 0.40f;
      int px = 120 + x, py = 120 + y;
      d.drawPixel(px, py, blend565(d.readPixel(px, py), TINT, alpha));
    }
  }
  float a = lead * DEG_TO_RAD;
  d.drawLine(120, 120, 120 + sinf(a) * R, 120 - cosf(a) * R, blend565(TINT, WHITE, 0.3f));
}

void drawTrail(lgfx::LGFXBase& d, const Aircraft& p, uint16_t color) {
  if (!p.trailN || !inRange(p)) return;
  int px, py;
  polarToXY(p.distance, p.bearing, px, py);
  for (int i = p.trailN - 1; i >= 0; --i) {
    int x, y;
    polarToXY(p.trail[i].d10 / 10.0f, p.trail[i].b10 / 10.0f, x, y);
    float age = float(p.trailN - i) / float(TRAIL_LEN + 1);
    d.drawLine(px, py, x, y, blend565(color, BG, 0.25f + age * 0.6f));
    px = x;
    py = y;
  }
}

void arrowAt(lgfx::LGFXBase& d, int x, int y, float headingDeg, int length, uint16_t color, bool hollow) {
  float h = headingDeg * DEG_TO_RAD;
  float dx = sinf(h), dy = -cosf(h), sx = -dy, sy = dx;
  int x0 = x + dx * length, y0 = y + dy * length;
  int x1 = x - dx * length * .6f + sx * length * .55f, y1 = y - dy * length * .6f + sy * length * .55f;
  int x2 = x - dx * length * .6f - sx * length * .55f, y2 = y - dy * length * .6f - sy * length * .55f;
  if (hollow) d.drawTriangle(x0, y0, x1, y1, x2, y2, color);
  else d.fillTriangle(x0, y0, x1, y1, x2, y2, color);
}

// Returns marker screen position (for panel placement), or false if off map.
bool markerXY(const Aircraft& p, int& x, int& y) {
  if (p.distance < 0 || p.bearing < 0) return false;
  if (!inRange(p)) {  // edge arrow outside the 96 px ring, clear of the panels
    float a = p.bearing * DEG_TO_RAD;
    x = 120 + lroundf(sinf(a) * 108);
    y = 120 - lroundf(cosf(a) * 108);
    return true;
  }
  polarToXY(p.distance, p.bearing, x, y);
  return true;
}

void planeMarker(lgfx::LGFXBase& d, const Aircraft& p, bool active) {
  int x, y;
  if (!markerXY(p, x, y)) return;
  bool emerg = p.emergency;
  uint16_t color = emerg ? (flashOn() ? EMERG : WHITE) : (active ? RED : markerColor(p));
  if (!inRange(p)) {
    if (!active && !emerg) return;
    arrowAt(d, x, y, p.bearing, 7, color, false);  // points outward = where it is
    return;
  }
  bool alerted = alertHex[0] && strcmp(alertHex, p.hex) == 0 && millis() < alertUntil;
  if (alerted) d.drawCircle(x, y, 12 + (millis() / 120) % 6, ORANGE);
  if (active) d.drawCircle(x, y, 10, color);
  float heading = p.track >= 0 ? p.track : p.bearing;
  if (p.ground) d.fillCircle(x, y, 2, color);
  else arrowAt(d, x, y, heading, active ? 7 : 5, color, false);
}

void drawPlaces(lgfx::LGFXBase& d) {
  for (const auto& pl : PLACES) {
    if (range() > pl.maxRange) continue;
    int x, y;
    geoToXY(pl.lat, pl.lon, x, y);
    int dx = x - 120, dy = y - 120;
    if (dx * dx + dy * dy > 100 * 100) continue;
    if (pl.airport) d.drawRect(x - 2, y - 2, 5, 5, MUTED);
    else d.fillCircle(x, y, 2, MUTED);
    textHalo(pl.name, x, y + 9, MUTED, F_SMALL);
  }
  // Home (receiver) at center.
  d.fillCircle(120, 120, 3, WHITE);
  textHalo("FRANCA", 114, 129, WHITE, F_SMALL, top_right);
}

void drawRings(lgfx::LGFXBase& d, uint16_t status) {
  d.drawCircle(120, 120, 117, status);
  d.drawCircle(120, 120, 116, status);
  d.drawCircle(120, 120, 96, GRID);
  d.drawCircle(120, 120, 48, GRID);
  d.drawCircle(120, 120, 24, GRID);
  d.drawFastHLine(24, 120, 192, GRID);
  d.drawFastVLine(120, 24, 192, GRID);
  float r = range();
  auto nm = [](float v) { return String(static_cast<int>(lroundf(v))); };
  // Labels sit on the ring crossings of the horizontal axis.
  textHalo(nm(r / 4), 120 + 24, 115, MUTED, F_SMALL, bottom_center);
  textHalo(nm(r / 2), 120 + 48, 115, MUTED, F_SMALL, bottom_center);
  textHalo(nm(r) + " NM", 120 - 96 + 2, 115, MUTED, F_SMALL, bottom_left);
}

struct Status {
  bool stale;
  uint16_t color;
  uint32_t age;
};

Status status() {
  uint32_t age = lastSuccess ? (millis() - lastSuccess) / 1000 : 0;
  bool stale = !online || !lastSuccess || age > 45 || (!feedOK && !count);
  uint16_t color = portal ? ORANGE : (!online ? RED : (stale ? ORANGE : CYAN));
  return {stale, color, age};
}

String headerLine(const Status& st, size_t onMap, uint16_t& color) {
  color = CYAN;
  if (portal) { color = ORANGE; return "CONFIGURAR WI-FI"; }
  if (refreshing) return "ATUALIZANDO...";
  if (millis() < bannerUntil) { color = bannerColor; return banner; }
  color = st.color;
  if (!online) return "SEM WI-FI";
  if (count && lastSuccess && st.age > 45) return "ATRASO " + String(st.age) + "s";
  if (errorText.length() && !count) return "FALHA FEED";
  if (!lastSuccess) return "AGUARDE";
  color = CYAN;
  return String(onMap) + "/" + String(count) + " VOOS";
}

// Header: two lines in a pill. topY = pill top.
void drawHeader(lgfx::LGFXBase& d, int topY, const Status& st, size_t onMap) {
  d.fillRoundRect(46, topY, 149, 34, 12, BG);
  d.drawRoundRect(46, topY, 149, 34, 12, PANEL);
  const char* title = "MEULAB · SIMK";
  int w = textW(title, F_SMALL);
  text(title, 115, topY + 10, WHITE, F_SMALL);
  int x = 115 + w / 2 + 9, y = topY + 10;
  if (muted || nightTime()) {  // status dot becomes a crossed speaker: sounds off (emergencies still sound)
    d.fillRect(x - 4, y - 2, 3, 5, st.color);
    d.fillTriangle(x - 2, y, x + 2, y - 4, x + 2, y + 4, st.color);
    d.drawLine(x - 5, y + 5, x + 4, y - 5, st.color);
  } else {
    d.fillCircle(x - 1, y, 3, st.color);
  }
  uint16_t color;
  String line = headerLine(st, onMap, color);
  text(line, 120, topY + 24, color, F_SMALL, middle_center, 138);
}

// Selected-aircraft card. topY = card top (height 56).
void drawCard(lgfx::LGFXBase& d, int topY, const Aircraft& p) {
  uint16_t border = p.emergency ? (flashOn() ? EMERG : WHITE) : (military(p) ? MIL : CYAN);
  d.fillRoundRect(44, topY, 153, 56, 14, BG);
  d.drawRoundRect(44, topY, 153, 56, 14, border);
  Airline al = airlineFor(p);
  if (al.logo24) {
    logo(d, al.logo24, 24, 52, topY + 5);
    text(label(p), 133, topY + 16, p.emergency ? EMERG : RED, F_CALL, middle_center, 110);
  } else {
    text(label(p), 120, topY + 16, p.emergency ? EMERG : RED, F_CALL, middle_center, 138);
  }
  String meta = (p.distance >= 0 ? String(p.distance, p.distance < 100 ? 1 : 0) : String("--")) + " NM";
  if (p.type[0]) meta = String(p.type) + " · " + meta;
  text(meta, 120, topY + 35, WHITE, F_MED, middle_center, 138);
  String values;
  if (p.ground || p.altitude >= 0) values = altText(p);
  if (p.speed >= 0) values += (values.length() ? "  ·  " : "") + String(p.speed, 0) + " kt";
  if (p.emergency) values = "SQUAWK " + String(p.squawk);
  int w = text(values, 120, topY + 48, MUTED, F_SMALL, middle_center, 128);
  vrateIcon(d, p, 120 + w / 2 + 8, topY + 48, MUTED);
}

void drawEmptyCard(lgfx::LGFXBase& d) {
  String msg = portal ? "CONFIGURAR"
             : !online ? "SEM WI-FI"
             : (errorText.length() ? "FALHA NO FEED" : (!lastSuccess ? "AGUARDE" : "CÉU LIVRE"));
  String sub = portal ? "Rede: " + String(PORTAL_SSID)
             : !online ? "Reconectando..."
             : (errorText.length() ? errorText : (!lastSuccess ? "Buscando aeronaves" : "Nenhum voo no alcance"));
  d.fillRoundRect(28, 92, 185, 56, 12, BG);
  d.drawRoundRect(28, 92, 185, 56, 12, PANEL);
  text(msg, 120, 110, WHITE, F_MED, middle_center, 172);
  text(sub, 120, 132, MUTED, F_SMALL, middle_center, 172);
}

void drawRadar(lgfx::LGFXBase& d, const Status& st) {
  // rgb565_t: header holds native RGB565; plain uint16_t* is read as byte-swapped.
  d.pushImage(0, 0, 240, 240, reinterpret_cast<const lgfx::rgb565_t*>(MAPS[zoom]));
  drawSweep(d);
  drawRings(d, st.color);

  size_t onMap = 0;
  for (size_t i = 0; i < count; ++i) {
    if (inRange(planes[i])) ++onMap;
    drawTrail(d, planes[i], i == selected ? RED : markerColor(planes[i]));
  }
  for (size_t i = 0; i < count; ++i) if (i != selected) planeMarker(d, planes[i], false);
  drawPlaces(d);
  if (count) planeMarker(d, planes[selected], true);

  bool hidden = millis() - lastInput > PANEL_HIDE_MS && millis() > bannerUntil && !refreshing && !portal &&
                count && !(count && planes[selected].emergency);
  if (!count) {
    drawHeader(d, 24, st, onMap);
    drawEmptyCard(d);
    return;
  }
  const Aircraft& p = planes[selected];
  int sx = 120, sy = 120;
  bool hasMarker = markerXY(p, sx, sy);
  if (hidden) {
    // Panels hidden: tag the selected aircraft right on the map.
    if (hasMarker) textHalo(label(p), sx, sy + (sy > 200 ? -16 : 15), RED, F_SMALL);
    return;
  }
  // Card goes on the half opposite the selected marker so it never covers it.
  bool cardTop = hasMarker && sy > 135;
  int cardY = cardTop ? 26 : 158;
  int headY = cardTop ? 178 : 24;
  bool headerCovers = hasMarker && sx > 46 && sx < 194 && sy > headY - 8 && sy < headY + 42;
  drawCard(d, cardY, p);
  if (!headerCovers) drawHeader(d, headY, st, onMap);
}

// ---- Detail screen ----------------------------------------------------------
// Round dial frame shared by detail / stats / clock screens.
void drawDial(lgfx::LGFXBase& d, const Status& st) {
  d.fillScreen(BG);
  d.drawCircle(120, 120, 117, st.color);
  d.drawCircle(120, 120, 116, PANEL);
  for (int deg = 0; deg < 360; deg += 15) {
    float a = (deg - 90) * DEG_TO_RAD;
    int inner = deg % 90 == 0 ? 106 : 110;
    d.drawLine(120 + cosf(a) * inner, 120 + sinf(a) * inner, 120 + cosf(a) * 113, 120 + sinf(a) * 113,
               deg % 90 == 0 ? MUTED : PANEL);
  }
}

void drawDetail(lgfx::LGFXBase& d, const Status& st) {
  drawDial(d, st);
  if (count && planes[selected].bearing >= 0) {  // direction of the aircraft from home
    float a = (planes[selected].bearing - 90.0f) * DEG_TO_RAD;
    d.fillCircle(120 + cosf(a) * 113, 120 + sinf(a) * 113, 4, CYAN);
  }

  if (!count) {
    String msg = portal ? "CONFIGURAR WI-FI" : !online ? "SEM WI-FI" : (errorText.length() ? "SEM DADOS" : "CÉU LIVRE");
    String sub = portal ? "Rede " + String(PORTAL_SSID) : !online ? "Reconectando..." : (errorText.length() ? errorText : "Nenhum voo no alcance");
    String hint = portal ? "Abra 192.168.4.1" : !online ? "Segure 5 s: configurar" : "";
    text(msg, 120, 100, WHITE, F_MED, middle_center, 200);
    text(sub, 120, 128, MUTED, F_SMALL, middle_center, 190);
    if (hint.length()) text(hint, 120, 150, CYAN, F_SMALL, middle_center, 190);
    return;
  }
  const auto& p = planes[selected];
  text(String(selected + 1) + " / " + String(count), 120, 28, MUTED, F_SMALL);
  uint16_t callColor = p.emergency ? (flashOn() ? EMERG : WHITE) : WHITE;
  Airline al = airlineFor(p);
  const lgfx::IFont* callFont = textW(label(p), F_BIG) > 196 ? F_CALL : F_BIG;
  int callW = textW(label(p), callFont);
  if (al.logo36 && callW + 44 <= 200) {
    int left = 120 - (callW + 44) / 2;
    logo(d, al.logo36, 36, left, 38);
    text(label(p), left + 44, 56, callColor, callFont, middle_left);
  } else {
    text(label(p), 120, 56, callColor, callFont, middle_center, 196);
  }
  String identity = p.reg;
  if (p.type[0]) identity += (identity.length() ? " · " : "") + String(p.type);
  if (!identity.length()) identity = p.call[0] ? String(p.hex) : String("SEM REGISTRO");
  text(identity, 120, 82, MUTED, F_MED, middle_center, 200);
  if (p.emergency) text("EMERGÊNCIA " + String(p.squawk), 120, 100, EMERG, F_SMALL, middle_center, 196);
  else if (military(p)) {
    text("MILITAR" + (p.desc[0] ? " · " + String(p.desc) : String()), 120, 100, MIL, F_SMALL, middle_center, 196);
  } else if (p.desc[0] || al.name) {
    String line = al.name ? String(al.name) : String();
    if (p.desc[0]) line += (line.length() ? " · " : "") + String(p.desc);
    text(line, 120, 100, CYAN, F_SMALL, middle_center, 196);
  }
  d.drawFastHLine(50, 112, 140, PANEL);

  auto cell = [&](const char* name, const String& value, int x, int y) {
    text(name, x, y, MUTED, F_SMALL);
    text(value, x, y + 17, WHITE, F_MED, middle_center, 100);
  };
  cell("ALTITUDE", altText(p), 68, 126);
  cell("VELOCIDADE", p.speed >= 0 ? String(p.speed, 0) + " kt" : String("--"), 172, 126);
  cell("VERTICAL", vrateText(p), 68, 162);
  cell("SQUAWK", p.squawk[0] ? String(p.squawk) : String("--"), 172, 162);
  String route = "RUMO " + (p.track >= 0 ? String(p.track, 0) + "°" : String("--")) + " · " +
                 (p.distance >= 0 ? String(p.distance, 1) : String("--")) + " NM";
  text(route, 120, 198, CYAN, F_SMALL, middle_center, 176);
  String footer = !online ? "SEM WI-FI"
                : (st.stale && lastSuccess ? "DADOS ANTIGOS " + String(st.age) + "s" : "ORDEM: " + String(sortName()));
  text(footer, 120, 214, st.stale ? ORANGE : MUTED, F_SMALL, middle_center, 150);
}

// ---- Stats screen -----------------------------------------------------------
void drawStats(lgfx::LGFXBase& d, const Status& st) {
  drawDial(d, st);
  struct tm t;
  char now[24] = "HOJE";
  if (localTime(t))  // dd/mm/aa · HH:MM (24 h)
    snprintf(now, sizeof now, "%02d/%02d/%02d · %02d:%02d", t.tm_mday, t.tm_mon + 1, t.tm_year % 100, t.tm_hour,
             t.tm_min);
  text(now, 120, 34, MUTED, F_SMALL, middle_center, 150);
  text(String(stats.n), 120, 64, WHITE, F_BIG);
  text(stats.n == 1 ? "voo único hoje" : "voos únicos hoje", 120, 90, CYAN, F_SMALL, middle_center, 170);
  d.drawFastHLine(50, 102, 140, PANEL);
  auto row = [&](const char* name, const String& value, int y, int maxW) {
    text(name, 120, y, MUTED, F_SMALL);
    text(value, 120, y + 16, WHITE, F_MED, middle_center, maxW);
  };
  row("MAIS LONGE", stats.maxDist >= 0 ? String(stats.maxDistCall) + " · " + String(stats.maxDist, 0) + " NM" : String("--"), 116, 200);
  row("MAIS ALTO", stats.maxAlt >= 0 ? String(stats.maxAltCall) + " · " + String(stats.maxAlt) + " ft" : String("--"), 150, 196);
  const AirlineCount* top = nullptr;
  for (size_t i = 0; i < stats.airN; ++i) if (!top || stats.air[i].n > top->n) top = &stats.air[i];
  String topText = "--";
  if (top) {
    Airline al = airlineByPrefix(top->icao);
    topText = String(al.name ? al.name : top->icao) + " · " + String(top->n);
  }
  row("TOP CIA", topText, 184, 170);
  if (stats.mil) text("MILITARES: " + String(stats.mil), 120, 219, MIL, F_SMALL, middle_center, 120);
  else text("CLIQUE: RADAR", 120, 219, MUTED, F_SMALL, middle_center, 120);
}

// ---- Idle clock -------------------------------------------------------------
size_t onMapCount() {
  size_t n = 0;
  for (size_t i = 0; i < count; ++i) if (inRange(planes[i])) ++n;
  return n;
}

bool wantClock(size_t onMap) {
  if (screen != Screen::Radar || portal || refreshing || millis() < bannerUntil) return false;
  if (millis() - lastInput < CLOCK_IDLE_MS) return false;
  for (size_t i = 0; i < count; ++i) if (planes[i].emergency) return false;
  return onMap == 0 || nightTime();
}

void drawClock(lgfx::LGFXBase& d, const Status& st, size_t onMap) {
  drawDial(d, st);
  static const char* const DAYS[] = {"DOM", "SEG", "TER", "QUA", "QUI", "SEX", "SÁB"};
  static const char* const MONTHS[] = {"JAN", "FEV", "MAR", "ABR", "MAI", "JUN",
                                       "JUL", "AGO", "SET", "OUT", "NOV", "DEZ"};
  struct tm t;
  bool ok = localTime(t);
  char hm[6] = "--:--";
  if (ok) snprintf(hm, sizeof hm, "%02d:%02d", t.tm_hour, t.tm_min);
  if (ok) text(String(DAYS[t.tm_wday % 7]) + " · " + String(t.tm_mday) + " " + MONTHS[t.tm_mon % 12], 120, 72, MUTED, F_SMALL);
  text(hm, 120, 116, WHITE, F_CLOCK);
  text(String(stats.n) + (stats.n == 1 ? " voo hoje" : " voos hoje"), 120, 158, CYAN, F_MED);
  text(onMap ? String(onMap) + " no alcance" : String("céu livre"), 120, 180, MUTED, F_SMALL);
  if (muted) text("SOM DESLIGADO", 120, 204, ORANGE, F_SMALL);
}

// ---- OTA progress -----------------------------------------------------------
void drawOta(lgfx::LGFXBase& d) {
  d.fillScreen(BG);
  d.drawCircle(120, 120, 100, PANEL);
  if (otaPct > 0) d.fillArc(120, 120, 100, 92, -90, -90 + otaPct * 360 / 100, CYAN);
  text("ATUALIZANDO", 120, 84, MUTED, F_SMALL);
  text(String(otaPct) + "%", 120, 120, WHITE, F_BIG);
  text("não desligue", 120, 156, ORANGE, F_SMALL);
}

void draw() {
  auto& d = gfx();
  Status st = status();
  clockActive = false;
  if (otaPct >= 0) {
    drawOta(d);
  } else if (screen == Screen::Detail) {
    drawDetail(d, st);
  } else if (screen == Screen::Stats) {
    drawStats(d, st);
  } else {
    size_t onMap = onMapCount();
    clockActive = wantClock(onMap);
    if (clockActive) drawClock(d, st, onMap);
    else drawRadar(d, st);
  }
  if (spriteOK) canvas->pushSprite(0, 0);
  lastDraw = millis();
}

// ---- Wi-Fi ------------------------------------------------------------------
void beginWiFi() {
  if (portal) return;  // portal owns the radio
  WiFi.mode(WIFI_STA);
  WiFi.setSleep(false);  // modem sleep stalls TLS downloads -> truncated feed
  WiFi.setAutoReconnect(true);
  // Placeholder secrets: reuse credentials already saved in NVS by a previous install.
  if (strlen(WIFI_SSID) == 0 || strcmp(WIFI_SSID, "SEU_WIFI") == 0) WiFi.begin();
  else WiFi.begin(WIFI_SSID, WIFI_PASSWORD);
  lastWiFiTry = millis();
  Serial.println("Wi-Fi connecting");
}

void startPortal() {
  if (portal) return;
  Serial.println("Wi-Fi setup portal");
  portal = new WiFiManager();
  portal->setConfigPortalBlocking(false);
  portal->setConfigPortalTimeout(PORTAL_TIMEOUT_S);
  portal->startConfigPortal(PORTAL_SSID);
  screen = Screen::Radar;
}

void servicePortal() {
  if (!portal) return;
  portal->process();
  if (WiFi.status() == WL_CONNECTED || !portal->getConfigPortalActive()) {
    portal->stopConfigPortal();
    delete portal;
    portal = nullptr;
    Serial.println("Wi-Fi setup portal closed");
    beginWiFi();
  }
}

// ---- OTA (Wi-Fi firmware upload) ---------------------------------------------
// Enabled only when secrets.h defines a non-empty OTA_PASSWORD.
void startOTA() {
#ifdef OTA_PASSWORD
  if (otaStarted || !strlen(OTA_PASSWORD)) return;
  ArduinoOTA.setHostname("meulab-airdial");
  ArduinoOTA.setPassword(OTA_PASSWORD);
  ArduinoOTA.onStart([] { otaPct = 0; draw(); });
  ArduinoOTA.onProgress([](unsigned int done, unsigned int total) {
    int pct = total ? static_cast<int>(done * 100ULL / total) : 0;
    if (pct != otaPct) { otaPct = pct; draw(); }
  });
  ArduinoOTA.onEnd([] { otaPct = 100; draw(); });
  ArduinoOTA.onError([](ota_error_t) {
    otaPct = -1;
    showBanner("OTA FALHOU", RED, 4000);
  });
  ArduinoOTA.begin();
  otaStarted = true;
  Serial.println("OTA ready: meulab-airdial.local");
#endif
}

// ---- Brightness -------------------------------------------------------------
void updateBrightness() {
  uint8_t level = dayBrightness;
  struct tm now;
  if (timeConfigured && getLocalTime(&now, 0) && (now.tm_hour < 6 || now.tm_hour >= 19)) level = nightBrightness;
  if (millis() - lastInput > DIM_MS) level = level * 2 / 5;
  if (level != currentBrightness) {
    currentBrightness = level;
    M5Dial.Display.setBrightness(level);
  }
}

// ---- Background fetch -------------------------------------------------------
// HTTPS + JSON parsing run in fetchTask (core 0) so the UI loop never blocks.
// The task fills `incoming`; loop() merges it into `planes` under feedMutex.
Aircraft incoming[MAX_AIRCRAFT];
size_t incomingCount = 0;
bool incomingReady = false;   // guarded by feedMutex
String incomingError;         // guarded by feedMutex; empty = success
volatile bool fetching = false;
SemaphoreHandle_t feedMutex = nullptr;
TaskHandle_t fetchTaskHandle = nullptr;

bool publish(const String& error, size_t n) {
  xSemaphoreTake(feedMutex, portMAX_DELAY);
  incomingError = error;
  incomingCount = n;
  incomingReady = true;
  xSemaphoreGive(feedMutex);
  return error.isEmpty();
}

// ArduinoJson reader over the TLS stream. Keeps reading while connected() OR
// bytes are still buffered (stock readers stop at close and drop the tail), and
// sleeps when idle so IDLE0 can feed the task watchdog. Streaming = no body buffer.
struct TlsReader {
  WiFiClient* s;
  uint32_t timeoutMs;
  int read() {
    uint32_t start = millis();
    while (millis() - start < timeoutMs) {
      if (s->available() > 0) {
        int c = s->read();
        if (c >= 0) return c;
      } else if (!s->connected()) {
        return -1;
      } else {
        vTaskDelay(pdMS_TO_TICKS(2));
      }
    }
    return -1;
  }
  size_t readBytes(char* buf, size_t len) {
    size_t n = 0;
    while (n < len) {
      int c = read();
      if (c < 0) break;
      buf[n++] = static_cast<char>(c);
    }
    return n;
  }
};

bool fetchOnce() {
  if (WiFi.status() != WL_CONNECTED) return publish("Sem Wi-Fi", 0);
  WiFiClientSecure client;
  client.setInsecure(); // Public, read-only feed; no credentials sent to server.
  client.setTimeout(8000);
  HTTPClient http;
  http.useHTTP10(true);  // no chunked encoding; body ends at close
  http.setTimeout(8000);
  if (!http.begin(client, FEED_URL)) return publish("URL indisponivel", 0);
  int code = http.GET();
  if (code != HTTP_CODE_OK) {
    http.end();
    return publish("HTTP " + String(code), 0);
  }

  // Parse one aircraft object at a time: the document only ever holds a single
  // aircraft (~1 KB) instead of the whole feed, leaving heap for TLS.
  JsonDocument filter;
  for (const char* key : {"flight", "r", "t", "hex", "desc", "r_dst", "r_dir", "alt_baro", "gs", "track",
                          "baro_rate", "geom_rate", "squawk", "emergency", "seen", "dbFlags"})
    filter[key] = true;
  TlsReader reader{http.getStreamPtr(), 8000};
  // Seek to the start of the "aircraft" array.
  static const char KEY[] = "\"aircraft\"";
  size_t matched = 0;
  int c;
  while ((c = reader.read()) >= 0 && KEY[matched]) matched = (c == KEY[matched]) ? matched + 1 : (c == KEY[0]);
  while (c >= 0 && c != '[') c = reader.read();
  if (c < 0) {
    http.end();
    Serial.printf("Fetch failed: no aircraft array (heap min %u)\n", ESP.getMinFreeHeap());
    return publish("JSON invalido", 0);
  }

  // loop() only try-locks, so holding the mutex while filling never blocks the UI.
  xSemaphoreTake(feedMutex, portMAX_DELAY);
  size_t n = 0;
  JsonDocument doc;
  bool ok = false;
  for (;;) {
    do c = reader.read(); while (c == ' ' || c == ',' || c == '\n' || c == '\r' || c == '\t');
    if (c == ']') { ok = true; break; }
    if (c != '{') break;
    // Re-feed the consumed '{' then let ArduinoJson read exactly one object.
    struct Prefixed {
      TlsReader& r; bool first = true;
      int read() { if (first) { first = false; return '{'; } return r.read(); }
      size_t readBytes(char* b, size_t len) {
        size_t k = 0;
        while (k < len) { int ch = read(); if (ch < 0) break; b[k++] = static_cast<char>(ch); }
        return k;
      }
    } pre{reader};
    DeserializationError err = deserializeJson(doc, pre, DeserializationOption::Filter(filter));
    if (err) {
      Serial.printf("Fetch failed: %s (heap free %u, min %u)\n", err.c_str(), ESP.getFreeHeap(), ESP.getMinFreeHeap());
      break;
    }
    if (n >= MAX_AIRCRAFT) continue;  // keep draining to validate the stream
    JsonObject obj = doc.as<JsonObject>();
    float seen = obj["seen"] | 999.0f;
    if (seen > 60) continue;
    Aircraft& p = incoming[n++];
    p = Aircraft();
    copyClean(p.call, obj["flight"] | "");
    copyClean(p.reg, obj["r"] | "");
    copyClean(p.type, obj["t"] | "");
    copyClean(p.hex, obj["hex"] | "", true);
    copyClean(p.desc, obj["desc"] | "", true);
    copyClean(p.squawk, obj["squawk"] | "");
    p.distance = obj["r_dst"] | -1.0f;
    p.bearing = obj["r_dir"] | -1.0f;
    p.speed = obj["gs"] | -1.0f;
    p.track = obj["track"] | -1.0f;
    p.flags = obj["dbFlags"] | 0;
    p.firstSeen = millis();
    JsonVariant alt = obj["alt_baro"];
    p.ground = alt.is<const char*>() && strcmp(alt.as<const char*>(), "ground") == 0;
    p.altitude = alt.is<int>() ? alt.as<int>() : (p.ground ? 0 : -1);
    JsonVariant rate = obj["baro_rate"].isNull() ? obj["geom_rate"] : obj["baro_rate"];
    if (rate.is<int>()) p.vrate = static_cast<int16_t>(std::max(-32000, std::min(32000, rate.as<int>())));
    const char* emergency = obj["emergency"] | "none";
    p.emergency = strcmp(emergency, "none") != 0 || !strcmp(p.squawk, "7500") || !strcmp(p.squawk, "7600") ||
                  !strcmp(p.squawk, "7700");
  }
  http.end();
  if (!ok) {
    xSemaphoreGive(feedMutex);
    return publish("JSON invalido", 0);
  }
  incomingError = "";
  incomingCount = n;
  incomingReady = true;
  xSemaphoreGive(feedMutex);
  return true;
}

void fetchTask(void*) {
  for (;;) {
    ulTaskNotifyTake(pdTRUE, portMAX_DELAY);
    // One quick retry on failure instead of waiting a full FETCH_MS cycle.
    if (!fetchOnce() && WiFi.status() == WL_CONNECTED) {
      vTaskDelay(pdMS_TO_TICKS(1500));
      fetchOnce();
    }
    fetching = false;
  }
}

void requestFetch() {
  fetching = true;
  lastFetch = millis();
  xTaskNotifyGive(fetchTaskHandle);
}

const Aircraft* findOld(const char* hex) {
  for (size_t i = 0; i < count; ++i) if (strcmp(planes[i].hex, hex) == 0) return &planes[i];
  return nullptr;
}

// a sorts before b in the current mode. Unknown values go last.
bool sortsBefore(const Aircraft& a, const Aircraft& b) {
  switch (sortMode) {
    case Sort::High: {
      int aa = a.ground ? 0 : a.altitude, bb = b.ground ? 0 : b.altitude;
      return aa > bb;
    }
    case Sort::New: return a.firstSeen > b.firstSeen;
    default:
      if (a.distance < 0) return false;
      if (b.distance < 0) return true;
      return a.distance < b.distance;
  }
}

// In-place stable insertion sort (n <= 48): no heap, unlike std::stable_sort.
void sortPlanes() {
  for (size_t i = 1; i < count; ++i) {
    Aircraft tmp = planes[i];
    size_t j = i;
    for (; j > 0 && sortsBefore(tmp, planes[j - 1]); --j) planes[j] = planes[j - 1];
    planes[j] = tmp;
  }
}

void selectByHex(const char* hex) {
  selected = 0;
  if (!hex[0]) return;
  for (size_t i = 0; i < count; ++i) if (strcmp(planes[i].hex, hex) == 0) { selected = i; return; }
}

void updateStats() {
  struct tm t;
  if (localTime(t)) {
    if (stats.yday >= 0 && stats.yday != t.tm_yday) stats = DayStats();
    stats.yday = t.tm_yday;
  }
  for (size_t i = 0; i < count; ++i) {
    const Aircraft& p = planes[i];
    uint32_t h = strtoul(p.hex, nullptr, 16);
    bool known = false;
    for (size_t k = 0; k < stats.n && !known; ++k) known = stats.seen[k] == h;
    if (!known && h && stats.n < MAX_SEEN) {
      stats.seen[stats.n++] = h;
      if (military(p)) ++stats.mil;
      if (airlineCall(p.call)) {
        size_t k = 0;
        while (k < stats.airN && strncmp(stats.air[k].icao, p.call, 3) != 0) ++k;
        if (k == stats.airN && stats.airN < 24) {
          memcpy(stats.air[k].icao, p.call, 3);
          stats.air[k].icao[3] = '\0';
          stats.air[k].n = 0;
          ++stats.airN;
        }
        if (k < stats.airN) ++stats.air[k].n;
      }
    }
    if (p.distance > stats.maxDist) {
      stats.maxDist = p.distance;
      copyClean(stats.maxDistCall, label(p).c_str());
    }
    if (!p.ground && p.altitude > stats.maxAlt) {
      stats.maxAlt = p.altitude;
      copyClean(stats.maxAltCall, label(p).c_str());
    }
  }
}

// Called from loop(): merges a finished fetch into the UI state (trails, alerts,
// selection). Returns true if it did.
bool applyFetchResult() {
  if (xSemaphoreTake(feedMutex, 0) != pdTRUE) return false;
  if (!incomingReady) {
    xSemaphoreGive(feedMutex);
    return false;
  }
  incomingReady = false;
  if (incomingError.length()) {
    errorText = incomingError;
    if (!count) feedOK = false;  // keep showing fresh data; staleness comes from age
    xSemaphoreGive(feedMutex);
    Serial.println("Feed error: " + errorText);
    if (lastFetchOk || refreshing) play(Snd::FeedFail);  // once per outage, or on manual refresh
    lastFetchOk = false;
    return true;
  }
  char keepHex[sizeof(Aircraft::hex)] = "";
  if (selected < count) strcpy(keepHex, planes[selected].hex);
  bool hadData = count > 0;
  const Aircraft* newEmergency = nullptr;
  const Aircraft* approaching = nullptr;
  const Aircraft* newMilitary = nullptr;
  for (size_t i = 0; i < incomingCount; ++i) {
    Aircraft& p = incoming[i];
    const Aircraft* old = findOld(p.hex);
    if (!old) {
      if (hadData && military(p) && !newMilitary) newMilitary = &p;
      continue;
    }
    p.firstSeen = old->firstSeen;
    // Trail: previous trail + previous position.
    memcpy(p.trail, old->trail, sizeof(p.trail));
    p.trailN = old->trailN;
    if (old->distance >= 0 && old->bearing >= 0 && fabsf(old->distance - p.distance) + fabsf(old->bearing - p.bearing) > 0.05f) {
      if (p.trailN == TRAIL_LEN) {
        memmove(p.trail, p.trail + 1, sizeof(TrailPt) * (TRAIL_LEN - 1));
        --p.trailN;
      }
      p.trail[p.trailN++] = {static_cast<int16_t>(old->distance * 10), static_cast<int16_t>(old->bearing * 10)};
    }
    if (p.emergency && !old->emergency) newEmergency = &p;
    if (hadData && p.distance >= 0 && p.distance <= APPROACH_NM && old->distance > APPROACH_NM && !approaching)
      approaching = &p;
  }
  // Brand-new emergency squawks also count (not only transitions).
  for (size_t i = 0; i < incomingCount && !newEmergency; ++i)
    if (incoming[i].emergency && !findOld(incoming[i].hex)) newEmergency = &incoming[i];

  String emergHex = newEmergency ? String(newEmergency->hex) : String();
  String alertMsg, alertId;
  if (newEmergency) {
    alertMsg = "EMERGÊNCIA " + String(newEmergency->squawk);
    alertId = newEmergency->hex;
  } else if (approaching) {
    alertMsg = "PRÓXIMO: " + label(*approaching);
    alertId = approaching->hex;
  } else if (newMilitary) {
    alertMsg = "MILITAR: " + label(*newMilitary);
    alertId = newMilitary->hex;
  }
  count = incomingCount;
  for (size_t i = 0; i < count; ++i) planes[i] = incoming[i];
  xSemaphoreGive(feedMutex);

  sortPlanes();
  selectByHex(keepHex);
  updateStats();
  if (alertMsg.length()) {
    copyClean(alertHex, alertId.c_str());
    alertUntil = millis() + ALERT_MS;
    showBanner(alertMsg, newEmergency ? EMERG : (approaching ? ORANGE : MIL), ALERT_MS);
    if (newEmergency) {  // jump to it, siren until acknowledged
      selectByHex(emergHex.c_str());
      copyClean(sirenHex, emergHex.c_str());
      sirenNext = millis() + SIREN_REPEAT_MS;
      play(Snd::Siren);
    } else {
      play(approaching ? Snd::Approach : Snd::Military);
    }
  }
  lastFetchOk = true;
  feedOK = true;
  lastSuccess = millis();
  errorText = "";
  Serial.printf("Feed OK: %u aircraft, max loop gap %u ms, heap min %u, largest %u\n",
                static_cast<unsigned>(count), static_cast<unsigned>(maxLoopGap), ESP.getMinFreeHeap(),
                ESP.getMaxAllocHeap());
  maxLoopGap = 0;
  return true;
}

// ---- Input ------------------------------------------------------------------
void setZoom(int delta) {
  int z = std::max(0, std::min(int(ZOOMS) - 1, int(zoom) + delta));
  if (z == int(zoom)) return;
  zoom = z;
  prefs.putUChar("zoom", zoom);
  showBanner("ZOOM " + String(static_cast<int>(range())) + " NM", CYAN, 1500);
}

void setSort(int delta) {
  sortMode = static_cast<Sort>((static_cast<int>(sortMode) + 3 + delta) % 3);
  prefs.putUChar("sort", static_cast<uint8_t>(sortMode));
  char keep[sizeof(Aircraft::hex)] = "";
  if (selected < count) strcpy(keep, planes[selected].hex);
  sortPlanes();
  selectByHex(keep);
  showBanner("ORDEM: " + String(sortName()), CYAN, 1500);
}

void toggleMute() {
  muted = !muted;
  prefs.putBool("mute", muted);
  showBanner(muted ? "SOM DESLIGADO" : "SOM LIGADO", muted ? ORANGE : CYAN, 1500);
  play(muted ? Snd::Mute : Snd::Unmute);
}

// Single tap: radar <-> detail (stats -> radar). Hidden radar panels: reveal only.
void tapAction() {
  bool wasHidden = screen == Screen::Radar && millis() - lastInput > PANEL_HIDE_MS;
  touchInput();
  if (!wasHidden) screen = screen == Screen::Radar ? Screen::Detail : Screen::Radar;
  dirty = true;
}

// Button click cycles radar -> detail -> stats -> radar.
void clickAction() {
  bool wasHidden = screen == Screen::Radar && millis() - lastInput > PANEL_HIDE_MS;
  touchInput();
  if (!wasHidden)
    screen = screen == Screen::Radar ? Screen::Detail : (screen == Screen::Detail ? Screen::Stats : Screen::Radar);
  dirty = true;
}

void handleInput() {
  auto& btn = M5Dial.BtnA;
  long encoder = M5Dial.Encoder.read();
  long steps = (encoder - lastEncoder) / 4;
  bool tapped = M5Dial.Touch.getDetail().wasClicked();

  // Clock face: the first input of any kind only wakes the radar.
  if (clockActive && (steps || btn.wasPressed() || tapped)) {
    lastEncoder += steps * 4;
    pressTurned = true;  // swallow this press: no click/refresh on release
    pendingTap = false;
    touchInput();
    clockActive = false;
    dirty = true;
    return;
  }

  if (steps) {
    lastEncoder += steps * 4;
    touchInput();
    if (btn.isPressed()) {  // hold + turn: zoom on radar, sort order on detail
      pressTurned = true;
      if (screen == Screen::Radar) { setZoom(steps > 0 ? 1 : -1); play(Snd::ZoomTick); }
      else if (screen == Screen::Detail) { setSort(steps > 0 ? 1 : -1); play(Snd::Tick); }
    } else if (count && screen != Screen::Stats) {
      long raw = static_cast<long>(selected) + steps;
      long next = raw % static_cast<long>(count);
      if (next < 0) next += count;
      selected = static_cast<size_t>(next);
      play(raw < 0 || raw >= static_cast<long>(count) ? Snd::Wrap : Snd::Tick);
    }
    dirty = true;  // coalesce: fast spins redraw once per loop pass, not per detent
  }

  if (btn.wasPressed()) {
    pressStart = millis();
    pressTurned = refreshFired = portalFired = false;
    touchInput();
  }
  if (btn.isPressed() && !pressTurned) {
    uint32_t held = millis() - pressStart;
    if (!refreshFired && held >= 1200) {
      refreshFired = true;
      play(Snd::Tick);
      if (online) {
        refreshing = true;
        lastFetch = 0;
      }
      dirty = true;
    }
    if (!portalFired && held >= 5000) {
      portalFired = true;
      refreshing = false;
      play(Snd::Mute);
      if (portal) servicePortal(); else startPortal();
      dirty = true;
    }
  }
  bool clicked = btn.wasReleased() && !pressTurned && !refreshFired && millis() - pressStart < 1000;
  if (clicked && millis() - lastAction > 250) {
    lastAction = millis();
    clickAction();
  }
  // Touch: double tap = mute; single tap fires after the double-tap window.
  if (tapped) {
    if (pendingTap && millis() - pendingTapAt < DOUBLE_TAP_MS) {
      pendingTap = false;
      touchInput();
      toggleMute();
      dirty = true;
    } else {
      pendingTap = true;
      pendingTapAt = millis();
    }
  }
  if (pendingTap && millis() - pendingTapAt >= DOUBLE_TAP_MS) {
    pendingTap = false;
    tapAction();
  }
}

// Repeats the emergency siren until acknowledged or the squawk clears.
void serviceSiren() {
  if (!sirenHex[0] || millis() < sirenNext) return;
  const Aircraft* p = findOld(sirenHex);
  if (!p || !p->emergency) { sirenHex[0] = '\0'; return; }
  play(Snd::Siren);
  sirenNext = millis() + SIREN_REPEAT_MS;
}
} // namespace

void setup() {
  Serial.begin(115200);
  auto cfg = M5.config();
  M5Dial.begin(cfg, true, false);
  M5Dial.Speaker.setVolume(48);
  prefs.begin("airdial", false);
  muted = prefs.getBool("mute", false);
  sortMode = static_cast<Sort>(std::min<uint8_t>(prefs.getUChar("sort", 0), 2));
  zoom = std::min<size_t>(prefs.getUChar("zoom", 0), ZOOMS - 1);
  bootMs = lastInput = millis();
  updateBrightness();
  loadFonts();
  canvas = new M5Canvas(&M5Dial.Display);
  canvas->setColorDepth(16);
  spriteOK = canvas->createSprite(240, 240) != nullptr;
  feedMutex = xSemaphoreCreateMutex();
  Serial.printf("Boot heap: free %u, largest %u, sprite %s\n", ESP.getFreeHeap(), ESP.getMaxAllocHeap(),
                spriteOK ? "ok" : "FAILED");
  // Measured peak stack use ~4.2 KB (TLS handshake incl.); 9 KB keeps margin. Core 0 = off the UI core.
  xTaskCreatePinnedToCore(fetchTask, "fetch", 9216, nullptr, 1, &fetchTaskHandle, 0);
  draw();
  beginWiFi();
  lastEncoder = M5Dial.Encoder.read();
#ifdef ARDUINO_ARCH_ESP32
  enableLoopWDT();  // loop() stuck > 5 s -> panic with backtrace on serial
#endif
}

void loop() {
  uint32_t now = millis();
  if (lastLoop) maxLoopGap = std::max(maxLoopGap, now - lastLoop);
  lastLoop = now;
  static uint32_t lastBeat = 0;
  if (now - lastBeat >= 10000) {  // heartbeat: proves loop() alive, shows UI state
    Serial.printf("HB t=%lus screen=%d clock=%d fetching=%d free=%u min=%u largest=%u snd=%u fetchStackFree=%u\n",
                  static_cast<unsigned long>(now / 1000), static_cast<int>(screen), clockActive, fetching,
                  ESP.getFreeHeap(), ESP.getMinFreeHeap(), ESP.getMaxAllocHeap(), static_cast<unsigned>(soundLen),
                  static_cast<unsigned>(uxTaskGetStackHighWaterMark(fetchTaskHandle)));
    lastBeat = now;
  }
  M5Dial.update();
  if (otaStarted) ArduinoOTA.handle();  // blocks for the whole upload; callbacks draw progress
  servicePortal();
  serviceSound();
  serviceSiren();
  bool nowOnline = WiFi.status() == WL_CONNECTED;
  if (nowOnline != online) {
    online = nowOnline;
    if (online && !timeConfigured) {
      configTzTime("<-03>3", "pool.ntp.org", "time.google.com");  // Brasilia, no DST
      timeConfigured = true;
    }
    if (online) startOTA();
    everOnline |= online;
    if (!online) feedOK = false;
    draw();
  }
  if (!online && !portal && millis() - lastWiFiTry > WIFI_RETRY_MS) beginWiFi();
  if (!everOnline && !portal && millis() - bootMs > PORTAL_AUTO_MS) startPortal();

  handleInput();
  if (online && !fetching && otaPct < 0 && (lastFetch == 0 || millis() - lastFetch >= FETCH_MS)) requestFetch();
  if (applyFetchResult()) {
    if (refreshing && errorText.isEmpty()) play(Snd::RefreshDone);
    refreshing = false;
    draw();
  }
  updateBrightness();
  uint32_t frameMs = clockActive ? 1000u : (screen == Screen::Radar ? 100u : 500u);
  if (dirty || millis() - lastDraw > frameMs) {
    dirty = false;
    draw();
  }
  delay(8);
}
